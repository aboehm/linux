## samples/rust/Kconfig
```kconfig
# SPDX-License-Identifier: GPL-2.0

menuconfig SAMPLES_RUST
	bool "Rust samples"
	depends on RUST
	help
	  You can build sample Rust kernel code here.

	  If unsure, say N.

if SAMPLES_RUST

config SAMPLE_RUST_MINIMAL
	tristate "Minimal"
	help
	  This option builds the Rust minimal module sample.

	  To compile this as a module, choose M here:
	  the module will be called rust_minimal.

	  If unsure, say N.

config SAMPLE_RUST_PRINT
	tristate "Printing macros"
	help
	  This option builds the Rust printing macros sample.

	  To compile this as a module, choose M here:
	  the module will be called rust_print.

	  If unsure, say N.

config SAMPLE_RUST_CHRDEV
	tristate "Character device"
	help
	  This option builds the Rust character device sample.

	  To compile this as a module, choose M here:
	  the module will be called rust_chrdev.

	  If unsure, say N.

config SAMPLE_RUST_CHRDEV_SOLUTION
	tristate "Character device"
	help
	  This option builds the solution for Rust character echo device for the workshop.

	  To compile this as a module, choose M here:
	  the module will be called rust_chrdev_solution.

	  If unsure, say N.

config SAMPLE_CHRDEV
	tristate "Native character device"
	help
	  This option builds the native character device sample.

	  To compile this as a module, choose M here:
	  the module will be called chrdev.

	  If unsure, say N.

config SAMPLE_RUST_HOSTPROGS
	bool "Host programs"
	help
	  This option builds the Rust host program samples.

	  If unsure, say N.

endif # SAMPLES_RUST
```
